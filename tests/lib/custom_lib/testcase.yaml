## tests/lib/custom_lib/testcase.yaml
```yaml
common:
  tags: extensibility
  platform_allow:
    - google_twinkie_v2
tests:
  lib.custom_lib: 
    extra_dtc_overlay_files:
    - ./boards/twinkie.overlay
```
